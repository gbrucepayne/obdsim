VERSION "Compatible with python-obd 0.7.1"

NS_ :

BS_:

BU_:

BO_ 2024 OBD2_RESPONSE: 8 Vector__XXX
 SG_ PIDS_A m0 : 31|32@0+ (1,0) [0|4294967295] "" Vector__XXX
 SG_ STATUS m1 : 31|32@0+ (1,0) [0|4294967295] "" Vector__XXX
 SG_ FREEZE_DTC m2 : 31|16@0+ (1,0) [0|65535] "" Vector__XXX
 SG_ FUEL_STATUS m3 : 31|16@0+ (1,0) [0|65535] "" Vector__XXX
 SG_ ENGINE_LOAD m4 : 31|8@0+ (0.39216,0) [0|100] "%" Vector__XXX
 SG_ COOLANT_TEMP m5 : 31|8@0+ (1,-40) [-40|215] "degC" Vector__XXX
 SG_ SHORT_FUEL_TRIM_1 m6 : 31|8@0+ (0.78125,-100) [-100|99.21875] "%" Vector__XXX
 SG_ LONG_FUEL_TRIM_1 m7 : 31|8@0+ (0.78125,-100) [-100|99.21875] "%" Vector__XXX
 SG_ SHORT_FUEL_TRIM_2 m8 : 31|8@0+ (0.78125,-100) [-100|99.21875] "%" Vector__XXX
 SG_ LONG_FUEL_TRIM_2 m9 : 31|8@0+ (0.78125,-100) [-100|99.21875] "%" Vector__XXX
 SG_ FUEL_PRESSURE m10 : 31|8@0+ (3,0) [0|765] "kPa" Vector__XXX
 SG_ INTAKE_PRESSURE m11 : 31|8@0+ (1,0) [0|255] "kPa" Vector__XXX
 SG_ RPM m12 : 31|16@0+ (0.25,0) [0|16383.75] "rpm" Vector__XXX
 SG_ SPEED m13 : 31|8@0+ (1,0) [0|255] "km/h" Vector__XXX
 SG_ TIMING_ADVANCE m14 : 31|8@0+ (0.5,-64) [-64|63.5] "deg before TDC" Vector__XXX
 SG_ INTAKE_TEMP m15 : 31|8@0+ (1,-40) [-40|215] "degC" Vector__XXX
 SG_ MAF m16 : 31|16@0+ (0.01,0) [0|655.35] "grams/sec" Vector__XXX
 SG_ THROTTLE_POS m17 : 31|8@0+ (0.39216,0) [0|100] "%" Vector__XXX
 SG_ AIR_STATUS m18 : 31|8@0+ (1,0) [0|255] "" Vector__XXX
 SG_ O2_B1S1_V m20 : 31|8@0+ (0.005,0) [0|1.275] "volts" Vector__XXX
 SG_ O2_B1S1_STFT m20 : 39|8@0+ (0.78125,-100) [-100|99.21875] "%" Vector__XXX
 SG_ O2_B1S2_V m21 : 31|8@0+ (0.005,0) [0|1.275] "volts" Vector__XXX
 SG_ O2_B1S2_STFT m21 : 39|8@0+ (0.78125,-100) [-100|99.21875] "%" Vector__XXX
 SG_ O2_B1S3_V m22 : 31|8@0+ (0.005,0) [0|1.275] "volts" Vector__XXX
 SG_ O2_B1S3_STFT m22 : 39|8@0+ (0.78125,-100) [-100|99.21875] "%" Vector__XXX
 SG_ O2_B1S4_V m23 : 31|8@0+ (0.005,0) [0|1.275] "volts" Vector__XXX
 SG_ O2_B1S4_STFT m23 : 39|8@0+ (0.78125,-100) [-100|99.21875] "%" Vector__XXX
 SG_ O2_B2S1_V m24 : 31|8@0+ (0.005,0) [0|1.275] "volts" Vector__XXX
 SG_ O2_B2S1_STFT m24 : 39|8@0+ (0.78125,-100) [-100|99.21875] "%" Vector__XXX
 SG_ O2_B2S2_V m25 : 31|8@0+ (0.005,0) [0|1.275] "volts" Vector__XXX
 SG_ O2_B2S2_STFT m25 : 39|8@0+ (0.78125,-100) [-100|99.21875] "%" Vector__XXX
 SG_ O2_B2S3_V m26 : 31|8@0+ (0.005,0) [0|1.275] "volts" Vector__XXX
 SG_ O2_B2S3_STFT m26 : 39|8@0+ (0.78125,-100) [-100|99.21875] "%" Vector__XXX
 SG_ O2_B2S4_V m27 : 31|8@0+ (0.005,0) [0|1.275] "volts" Vector__XXX
 SG_ O2_B2S4_STFT m27 : 39|8@0+ (0.78125,-100) [-100|99.21875] "%" Vector__XXX
 SG_ OBD_COMPLIANCE m28 : 31|8@0+ (1,0) [0|255] "" Vector__XXX
 SG_ RUN_TIME m31 : 31|16@0+ (1,0) [0|65535] "seconds" Vector__XXX
 SG_ PIDS_B m32 : 31|32@0+ (1,0) [0|4294967295] "" Vector__XXX
 SG_ DISTANCE_W_MIL m33 : 31|16@0+ (1,0) [0|65535] "km" Vector__XXX
 SG_ FUEL_RAIL_PRESSURE_VAC m34 : 31|16@0+ (0.079,0) [0|5177.265] "kPa" Vector__XXX
 SG_ FUEL_RAIL_PRESSURE_DIRECT m35 : 31|16@0+ (10,0) [0|655350] "kPa" Vector__XXX
 SG_ O2_S1_WR_VOLTAGE_R m36 : 31|16@0+ (3.0517578125E-005,0) [0|2] "ratio" Vector__XXX
 SG_ O2_S1_WR_VOLTAGE_V m36 : 47|16@0+ (0.0001220703125,0) [0|2] "volts" Vector__XXX
 SG_ O2_S2_WR_VOLTAGE_R m37 : 31|16@0+ (3.0517578125E-005,0) [0|2] "ratio" Vector__XXX
 SG_ O2_S2_WR_VOLTAGE_V m37 : 47|16@0+ (0.0001220703125,0) [0|8] "volts" Vector__XXX
 SG_ O2_S3_WR_VOLTAGE_R m38 : 31|16@0+ (3.0517578125E-005,0) [0|2] "ratio" Vector__XXX
 SG_ O2_S3_WR_VOLTAGE_V m38 : 47|16@0+ (0.0001220703125,0) [0|8] "volts" Vector__XXX
 SG_ O2_S4_WR_VOLTAGE_R m39 : 31|16@0+ (3.0517578125E-005,0) [0|2] "ratio" Vector__XXX
 SG_ O2_S4_WR_VOLTAGE_V m39 : 47|16@0+ (0.0001220703125,0) [0|8] "volts" Vector__XXX
 SG_ O2_S5_WR_VOLTAGE_R m40 : 31|16@0+ (3.0517578125E-005,0) [0|2] "ratio" Vector__XXX
 SG_ O2_S5_WR_VOLTAGE_V m40 : 47|16@0+ (0.0001220703125,0) [0|8] "volts" Vector__XXX
 SG_ O2_S6_WR_VOLTAGE_R m41 : 31|16@0+ (3.0517578125E-005,0) [0|2] "ratio" Vector__XXX
 SG_ O2_S6_WR_VOLTAGE_V m41 : 47|16@0+ (0.0001220703125,0) [0|8] "volts" Vector__XXX
 SG_ O2_S7_WR_VOLTAGE_R m42 : 31|16@0+ (3.0517578125E-005,0) [0|2] "ratio" Vector__XXX
 SG_ O2_S7_WR_VOLTAGE_V m42 : 47|16@0+ (0.0001220703125,0) [0|8] "volts" Vector__XXX
 SG_ O2_S8_WR_VOLTAGE_R m43 : 31|16@0+ (3.0517578125E-005,0) [0|2] "ratio" Vector__XXX
 SG_ O2_S8_WR_VOLTAGE_V m43 : 47|16@0+ (0.0001220703125,0) [0|8] "volts" Vector__XXX
 SG_ COMMANDED_EGR m44 : 31|8@0+ (0.392156862745098,0) [0|100] "%" Vector__XXX
 SG_ EGR_ERROR m45 : 31|8@0+ (0.78125,-100) [-100|99.21875] "%" Vector__XXX
 SG_ EVAPORATIVE_PURGE m46 : 31|8@0+ (0.392156862745098,0) [0|100] "%" Vector__XXX
 SG_ FUEL_LEVEL m47 : 31|8@0+ (0.392156862745098,0) [0|100] "%" Vector__XXX
 SG_ WARMUPS_SINCE_DTC_CLEAR m48 : 31|8@0+ (1,0) [0|255] "count" Vector__XXX
 SG_ DISTANCE_SINCE_DTC_CLEAR m49 : 31|16@0+ (1,0) [0|65535] "km" Vector__XXX
 SG_ EVAP_VAPOR_PRESSURE m50 : 31|16@0- (0.25,0) [-8192|8191.75] "Pa" Vector__XXX
 SG_ BAROMETRIC_PRESSURE m51 : 31|8@0+ (1,0) [0|255] "kPa" Vector__XXX
 SG_ O2_S1_WR_CURRENT_R m52 : 31|16@0+ (3.0517578125E-005,0) [0|2] "ratio" Vector__XXX
 SG_ O2_S1_WR_CURRENT_I m52 : 47|16@0+ (0.00390625,-128) [-128|128] "mA" Vector__XXX
 SG_ O2_S2_WR_CURRENT_R m53 : 31|16@0+ (3.0517578125E-005,0) [0|2] "ratio" Vector__XXX
 SG_ O2_S2_WR_CURRENT_I m53 : 47|16@0+ (0.00390625,-128) [-128|128] "mA" Vector__XXX
 SG_ O2_S3_WR_CURRENT_R m54 : 31|16@0+ (3.0517578125E-005,0) [0|2] "ratio" Vector__XXX
 SG_ O2_S3_WR_CURRENT_I m54 : 47|16@0+ (0.00390625,-128) [-128|128] "mA" Vector__XXX
 SG_ O2_S4_WR_CURRENT_R m55 : 31|16@0+ (3.0517578125E-005,0) [0|2] "ratio" Vector__XXX
 SG_ O2_S4_WR_CURRENT_I m55 : 47|16@0+ (0.00390625,-128) [-128|128] "mA" Vector__XXX
 SG_ O2_S5_WR_CURRENT_R m56 : 31|16@0+ (3.0517578125E-005,0) [0|2] "ratio" Vector__XXX
 SG_ O2_S5_WR_CURRENT_I m56 : 47|16@0+ (0.00390625,-128) [-128|128] "mA" Vector__XXX
 SG_ O2_S6_WR_CURRENT_R m57 : 31|16@0+ (3.0517578125E-005,0) [0|2] "ratio" Vector__XXX
 SG_ O2_S6_WR_CURRENT_I m57 : 47|16@0+ (0.00390625,-128) [-128|128] "mA" Vector__XXX
 SG_ O2_S7_WR_CURRENT_R m58 : 31|16@0+ (3.0517578125E-005,0) [0|2] "ratio" Vector__XXX
 SG_ O2_S7_WR_CURRENT_I m58 : 47|16@0+ (0.00390625,-128) [-128|128] "mA" Vector__XXX
 SG_ O2_S8_WR_CURRENT_R m59 : 31|16@0+ (3.0517578125E-005,0) [0|2] "ratio" Vector__XXX
 SG_ O2_S8_WR_CURRENT_I m59 : 47|16@0+ (0.00390625,-128) [-128|128] "mA" Vector__XXX
 SG_ CATALYST_TEMP_B1S1 m60 : 31|16@0+ (0.1,-40) [-40|6513.5] "degC" Vector__XXX
 SG_ CATALYST_TEMP_B2S1 m61 : 31|16@0+ (0.1,-40) [-40|6513.5] "degC" Vector__XXX
 SG_ CATALYST_TEMP_B1S2 m62 : 31|16@0+ (0.1,-40) [-40|6513.5] "degC" Vector__XXX
 SG_ CATALYST_TEMP_B2S2 m63 : 31|16@0+ (0.1,-40) [-40|6513.5] "degC" Vector__XXX
 SG_ PIDS_C m64 : 31|32@0+ (1,0) [0|4294967295] "" Vector__XXX
 SG_ STATUS_DRIVE_CYCLE m65 : 31|32@0+ (1,0) [0|4294967295] "" Vector__XXX
 SG_ CONTROL_MODULE_VOLTAGE m66 : 31|16@0+ (0.001,0) [0|65.535] "V" Vector__XXX
 SG_ ABSOLUTE_LOAD m67 : 31|16@0+ (0.392156862745098,0) [0|25700] "%" Vector__XXX
 SG_ COMMANDED_EQUIV_RATIO m68 : 31|16@0+ (3.0517578125E-005,0) [0|2] "ratio" Vector__XXX
 SG_ RELATIVE_THROTTLE_POS m69 : 31|8@0+ (0.392156862745098,0) [0|100] "%" Vector__XXX
 SG_ AMBIANT_AIR_TEMP m70 : 31|8@0+ (1,-40) [-40|215] "degC" Vector__XXX
 SG_ THROTTLE_POS_B m71 : 31|8@0+ (0.392156862745098,0) [0|100] "%" Vector__XXX
 SG_ THROTTLE_POS_C m72 : 31|8@0+ (0.392156862745098,0) [0|100] "%" Vector__XXX
 SG_ ACCELERATOR_POS_D m73 : 31|8@0+ (0.392156862745098,0) [0|100] "%" Vector__XXX
 SG_ ACCELERATOR_POS_E m74 : 31|8@0+ (0.392156862745098,0) [0|100] "%" Vector__XXX
 SG_ ACCELERATOR_POS_F m75 : 31|8@0+ (0.392156862745098,0) [0|100] "%" Vector__XXX
 SG_ THROTTLE_ACTUATOR m76 : 31|8@0+ (0.392156862745098,0) [0|100] "%" Vector__XXX
 SG_ RUN_TIME_MIL m77 : 31|16@0+ (1,0) [0|65535] "minutes" Vector__XXX
 SG_ TIME_SINCE_DTC_CLEARED m78 : 31|16@0+ (1,0) [0|65535] "minutes" Vector__XXX
 SG_ MAX_FAER_R m79 : 31|8@0+ (1,0) [0|255] "ratio" Vector__XXX
 SG_ MAX_FAER_V m79 : 39|8@0+ (1,0) [0|255] "V" Vector__XXX
 SG_ MAX_FAER_I m79 : 47|8@0+ (1,0) [0|255] "mA" Vector__XXX
 SG_ MAX_FAER_P m79 : 55|8@0+ (10,0) [0|2550] "kPa" Vector__XXX
 SG_ MAX_MAF m80 : 31|8@0+ (10,0) [0|2550] "g/s" Vector__XXX
 SG_ FUEL_TYPE m81 : 31|8@0+ (1,0) [0|255] "" Vector__XXX
 SG_ ETHANOL_PERCENT m82 : 31|8@0+ (0.392156862745098,0) [0|100] "%" Vector__XXX
 SG_ EVAP_VAPOR_PRESSURE_ABS m83 : 31|16@0+ (0.005,0) [0|327.675] "kPa" Vector__XXX
 SG_ EVAP_VAPOR_PRESSURE_ALT m84 : 31|16@0+ (1,-32767) [-32767|32768] "Pa" Vector__XXX
 SG_ SHORT_O2_TRIM_B1 m85 : 31|8@0+ (0.78125,-100) [-100|99.21875] "%" Vector__XXX
 SG_ SHORT_O2_TRIM_B3 m85 : 39|8@0+ (0.78125,-100) [-100|99.21875] "%" Vector__XXX
 SG_ LONG_O2_TRIM_B1 m86 : 31|8@0+ (0.78125,-100) [-100|99.21875] "%" Vector__XXX
 SG_ LONG_O2_TRIM_B3 m86 : 39|8@0+ (0.78125,-100) [-100|99.21875] "%" Vector__XXX
 SG_ SHORT_O2_TRIM_B2 m87 : 31|8@0+ (0.78125,-100) [-100|99.21875] "%" Vector__XXX
 SG_ SHORT_O2_TRIM_B4 m87 : 39|8@0+ (0.78125,-100) [-100|99.21875] "%" Vector__XXX
 SG_ LONG_O2_TRIM_B2 m88 : 31|8@0+ (0.78125,-100) [-100|99.21875] "%" Vector__XXX
 SG_ LONG_O2_TRIM_B4 m88 : 39|8@0+ (0.78125,-100) [-100|99.21875] "%" Vector__XXX
 SG_ FUEL_RAIL_PRESSURE_ABS m89 : 31|16@0+ (10,0) [0|655350] "kPa" Vector__XXX
 SG_ RELATIVE_ACCEL_POS m90 : 31|8@0+ (0.392156862745098,0) [0|100] "%" Vector__XXX
 SG_ HYBRID_BATTERY_REMAINING m91 : 31|8@0+ (0.392156862745098,0) [0|100] "%" Vector__XXX
 SG_ OIL_TEMP m92 : 31|8@0+ (1,-40) [-40|215] "degC" Vector__XXX
 SG_ FUEL_INJECT_TIMING m93 : 31|16@0+ (0.0078125,-210) [-210|301.9921875] "deg" Vector__XXX
 SG_ FUEL_RATE m94 : 31|16@0+ (0.05,0) [0|3276.75] "L/h" Vector__XXX
 SG_ S1_PID_5F_EmissionReq m95 : 31|8@0+ (1,0) [0|255] "" Vector__XXX
 SG_ S1_PID_60_PIDsSupported_61_80 m96 : 31|32@0+ (1,0) [0|4294967295] "" Vector__XXX
 SG_ S1_PID_61_DemandEngTorqPct m97 : 31|8@0+ (1,-125) [-125|130] "%" Vector__XXX
 SG_ S1_PID_62_ActualEngTorqPct m98 : 31|8@0+ (1,-125) [-125|130] "%" Vector__XXX
 SG_ S1_PID_63_EngRefTorq m99 : 31|16@0+ (1,0) [0|65535] "Nm" Vector__XXX
 SG_ S1_PID_64_EngPctTorq_Idle m100 : 31|8@0+ (1,-125) [-125|130] "%" Vector__XXX
 SG_ S1_PID_64_EngPctTorq_EP1 m100 : 39|8@0+ (1,-125) [-125|130] "%" Vector__XXX
 SG_ S1_PID_64_EngPctTorq_EP2 m100 : 47|8@0+ (1,-125) [-125|130] "%" Vector__XXX
 SG_ S1_PID_64_EngPctTorq_EP3 m100 : 55|8@0+ (1,-125) [-125|130] "%" Vector__XXX
 SG_ S1_PID_64_EngPctTorq_EP4 m100 : 63|8@0+ (1,-125) [-125|130] "%" Vector__XXX
 SG_ S1_PID_65_AuxInputOutput m101 : 31|8@0+ (1,0) [0|255] "" Vector__XXX
 SG_ S1_PID_66_MAFSensor m102 : 31|8@0+ (1,0) [0|255] "" Vector__XXX
 SG_ S1_PID_67_EngineCoolantTemp m103 : 31|8@0+ (1,0) [0|255] "" Vector__XXX
 SG_ S1_PID_68_IntakeAirTempSens m104 : 31|8@0+ (1,0) [0|255] "" Vector__XXX
 SG_ S1_PID_69_CmdEGR_EGRError m105 : 31|8@0+ (1,0) [0|255] "" Vector__XXX
 SG_ S1_PID_6A_CmdDieselIntAir m106 : 31|8@0+ (1,0) [0|255] "" Vector__XXX
 SG_ S1_PID_6B_ExhaustGasTemp m107 : 31|8@0+ (1,0) [0|255] "" Vector__XXX
 SG_ S1_PID_6C_CmdThrottleActRel m108 : 31|8@0+ (1,0) [0|255] "" Vector__XXX
 SG_ S1_PID_6D_FuelPresContrSys m109 : 31|8@0+ (1,0) [0|255] "" Vector__XXX
 SG_ S1_PID_6E_InjPresContrSys m110 : 31|8@0+ (1,0) [0|255] "" Vector__XXX
 SG_ S1_PID_6F_TurboComprPres m111 : 31|8@0+ (1,0) [0|255] "" Vector__XXX
 SG_ S1_PID_70_BoostPresCntrl m112 : 31|8@0+ (1,0) [0|255] "" Vector__XXX
 SG_ S1_PID_80_PIDsSupported_81_A0 m128 : 31|32@0+ (1,0) [0|4294967295] "" Vector__XXX
 SG_ S1_PID_8E_EngFrictionPctTorq m142 : 31|8@0+ (1,-125) [-125|130] "%" Vector__XXX
 SG_ S1_PID_A0_PIDsSupported_A1_C0 m160 : 31|32@0+ (1,0) [0|4294967295] "" Vector__XXX
 SG_ S1_PID_C0_PIDsSupported_C1_E0 m192 : 31|32@0+ (1,0) [0|4294967295] "" Vector__XXX
 SG_ S2_PID_02_FreezeDTC m2 : 31|16@0+ (1,0) [0|65535] "" Vector__XXX
 SG_ PID_MODE_01 m1M : 23|8@0+ (1,0) [0|255] "" Vector__XXX
 SG_ PID_MODE_02 m2M : 23|8@0+ (1,0) [0|255] "" Vector__XXX
 SG_ service M : 11|4@0+ (1,0) [0|15] "" Vector__XXX
 SG_ response : 15|4@0+ (1,0) [0|15] "" Vector__XXX
 SG_ length : 7|8@0+ (1,0) [0|255] "" Vector__XXX

BO_ 2015 OBD2_REQUEST: 8 Vector__XXX
 SG_ length : 7|8@0+ (1,0) [0|255] "" Vector__XXX
 SG_ request : 15|4@0+ (1,0) [0|15] "" Vector__XXX
 SG_ service M : 11|4@0+ (1,0) [0|15] "" Vector__XXX
 SG_ PID_MODE_01 m1M : 23|8@0+ (1,0) [0|255] "" Vector__XXX

CM_ BO_ 2024 "OBD2 DBC developed by canmatrix & CSS Electronics - for questions contact us at www.csselectronics.com";
CM_ SG_ 2024 PIDS_A "PIDs supported [01 - 20] - Bit encoded [A7..D0] == [PID $01..PID $20]. See OBD-II PIDs on Wikipedia";
CM_ SG_ 2024 STATUS "Monitor status since DTCs cleared (includes malfunction indicator lamp (MIL) status and number of DTCs) ";
CM_ SG_ 2024 PIDS_B "PIDs supported [21 - 40] - Bit encoded [A7..D0] == [PID $21..PID $40]. See OBD-II PIDs on Wikipedia";
CM_ SG_ 2024 PIDS_C "PIDs supported [41 - 60] - Bit encoded [A7..D0] == [PID $41..PID $60]. See OBD-II PIDs on Wikipedia";
CM_ SG_ 2024 S1_PID_60_PIDsSupported_61_80 "PIDs supported [61 - 80] - Bit encoded [A7..D0] == [PID $61..PID $80]. See OBD-II PIDs on Wikipedia";
CM_ SG_ 2024 S1_PID_80_PIDsSupported_81_A0 "PIDs supported [81 - A0] - Bit encoded [A7..D0] == [PID $81..PID $A0]. See OBD-II PIDs on Wikipedia";
CM_ SG_ 2024 S1_PID_A0_PIDsSupported_A1_C0 "PIDs supported [A1 - C0] - Bit encoded [A7..D0] == [PID $A1..PID $C0]. See OBD-II PIDs on Wikipedia";
CM_ SG_ 2024 S1_PID_C0_PIDsSupported_C1_E0 "PIDs supported [C1 - E0] - Bit encoded [A7..D0] == [PID $C1..PID $E0]. See OBD-II PIDs on Wikipedia";

BA_DEF_ BO_  "VFrameFormat" ENUM  "StandardCAN","ExtendedCAN","StandardCAN_FD","ExtendedCAN_FD","J1939PG";
BA_DEF_  "ProtocolType" STRING ;
BA_DEF_DEF_  "VFrameFormat" "";
BA_DEF_DEF_  "ProtocolType" "";
BA_ "ProtocolType" "OBD2";
BA_ "VFrameFormat" BO_ 2024 0;
VAL_ 2024 FUEL_STATUS 1 "Open loop (insuff. eng. temp.)" 2 "Closed loop (oxy sens)" 4 "Open loop (eng. load, fuel cut)" 8 "Open loop (system failure)" 16 "Closed loop (feedback issue)" ;
VAL_ 2024 AIR_STATUS 1 "Upstream" 2 "Downstream catalytic conv" 4 "From outside atmosphere/off" 8 "Pump cmd on for diagn." ;
VAL_ 2024 OBD_COMPLIANCE 1 "OBD-II as defined by the CARB" 2 "OBD as defined by the EPA" 3 "OBD and OBD-II" 4 "OBD-I" 5 "Not OBD compliant" 6 "EOBD (Europe)" 7 "EOBD and OBD-II" 8 "EOBD and OBD" 9 "EOBD, OBD and OBD II" 10 "JOBD (Japan)" 11 "JOBD and OBD II" 12 "JOBD and EOBD" 13 "JOBD, EOBD, and OBD II" 14 "Reserved" 15 "Reserved" 16 "Reserved" 17 "Eng. Manu. Diag. (EMD)" 18 "EMD Enhanced (EMD+)" 19 "HD OBD-C" 20 "HD OBD" 21 "WWH OBD" 22 "Reserved" 23 "HD EOBD-I" 24 "HD EOBD-I N" 25 "HD EOBD-II" 26 "HD EOBD-II N" 27 "Reserved" 28 "OBDBr-1" 29 "OBDBr-2" 30 "KOBD" 31 "IOBD I" 32 "IOBD II" 33 "HD EOBD-IV" 34 "Reserved" 35 "Reserved" ;
VAL_ 2024 FUEL_TYPE 0 "Not available" 1 "Gasoline" 2 "Methanol" 3 "Ethanol" 4 "Diesel" 5 "LPG" 6 "CNG" 7 "Propane" 8 "Electric" 9 "Bifuel running Gasoline" 10 "Bifuel running Methanol" 11 "Bifuel running Ethanol" 12 "Bifuel running LPG" 13 "Bifuel running CNG" 14 "Bifuel running Propane" 15 "Bifuel running Electricity" 16 "Bifuel electric/comb. eng." 17 "Hybrid gasoline" 18 "Hybrid Ethanol" 19 "Hybrid Diesel" 20 "Hybrid Electric" 21 "Hybrid running electric/comb." 22 "Hybrid Regenerative" 23 "Bifuel running diesel" ;
VAL_ 2024 PID_MODE_01 0 "PIDS_A" 1 "STATUS" 2 "FREEZE_DTC" 3 "FUEL_STATUS" 4 "ENGINE_LOAD" 5 "COOLANT_TEMP" 6 "SHORT_FUEL_TRIM_1" 7 "LONG_FUEL_TRIM_1" 8 "SHORT_FUEL_TRIM_2" 9 "LONG_FUEL_TRIM_2" 10 "FUEL_PRESSURE" 11 "INTAKE_PRESSURE" 12 "RPM" 13 "SPEED" 14 "TIMING_ADVANCE" 15 "INTAKE_TEMP" 16 "MAF" 17 "THROTTLE_POS" 18 "AIR_STATUS" 20 "S1_PID_14_OxySensor1" 21 "S1_PID_15_OxySensor2" 22 "S1_PID_16_OxySensor3" 23 "S1_PID_17_OxySensor4" 24 "S1_PID_18_OxySensor5" 25 "S1_PID_19_OxySensor6" 26 "S1_PID_1A_OxySensor7" 27 "S1_PID_1B_OxySensor8" 28 "OBD_COMPLIANCE" 31 "RUN_TIME" 32 "PIDS_B" 33 "DISTANCE_W_MIL" 34 "FUEL_RAIL_PRESSURE_VAC" 35 "FUEL_RAIL_PRESSURE_DIRECT" 36 "S1_PID_24_OxySensor1" 37 "S1_PID_25_OxySensor2" 38 "S1_PID_26_OxySensor3" 39 "S1_PID_27_OxySensor4" 40 "S1_PID_28_OxySensor5" 41 "S1_PID_29_OxySensor6" 42 "S1_PID_2A_OxySensor7" 43 "S1_PID_2B_OxySensor8" 44 "COMMANDED_EGR" 45 "EGR_ERROR" 46 "EVAPORATIVE_PURGE" 47 "FUEL_LEVEL" 48 "WARMUPS_SINCE_DTC_CLEAR" 49 "DISTANCE_SINCE_DTC_CLEAR" 50 "EVAP_VAPOR_PRESSURE" 51 "BAROMETRIC_PRESSURE" 52 "S1_PID_34_OxySensor1" 53 "S1_PID_35_OxySensor2" 54 "S1_PID_36_OxySensor3" 55 "S1_PID_37_OxySensor4" 56 "S1_PID_38_OxySensor5" 57 "S1_PID_39_OxySensor6" 58 "S1_PID_3A_OxySensor7" 59 "S1_PID_3B_OxySensor8" 60 "CATALYST_TEMP_B1S1" 61 "CATALYST_TEMP_B2S1" 62 "CATALYST_TEMP_B1S2" 63 "CATALYST_TEMP_B2S2" 64 "PIDS_C" 65 "STATUS_DRIVE_CYCLE" 66 "CONTROL_MODULE_VOLTAGE" 67 "ABSOLUTE_LOAD" 68 "COMMANDED_EQUIV_RATIO" 69 "RELATIVE_THROTTLE_POS" 70 "AMBIANT_AIR_TEMP" 71 "THROTTLE_POS_B" 72 "THROTTLE_POS_C" 73 "ACCELERATOR_POS_D" 74 "ACCELERATOR_POS_E" 75 "ACCELERATOR_POS_F" 76 "THROTTLE_ACTUATOR" 77 "RUN_TIME_MIL" 78 "TIME_SINCE_DTC_CLEARED" 79 "S1_PID_4F_MaxMultiple" 80 "MAX_MAF" 81 "FUEL_TYPE" 82 "ETHANOL_PERCENT" 83 "EVAP_VAPOR_PRESSURE_ABS" 84 "EVAP_VAPOR_PRESSURE_ALT" 85 "S1_PID_55_ShortSecOxyTrimBankX" 86 "S1_PID_56_LongSecOxyTrimBankX" 87 "S1_PID_57_ShortSecOxyTrimBankX" 88 "S1_PID_58_LongSecOxyTrimBankX" 89 "FUEL_RAIL_PRESSURE_ABS" 90 "RELATIVE_ACCEL_POS" 91 "HYBRID_BATTERY_REMAINING" 92 "OIL_TEMP" 93 "FUEL_INJECT_TIMING" 94 "FUEL_RATE" 95 "S1_PID_5F_EmissionReq" 96 "S1_PID_60_PIDsSupported_61_80" 97 "S1_PID_61_DemandEngTorqPct" 98 "S1_PID_62_ActualEngTorqPct" 99 "S1_PID_63_EngRefTorq" 100 "S1_PID_64_EngPctTorq" 101 "S1_PID_65_AuxInputOutput" 102 "S1_PID_66_MAFSensor" 103 "S1_PID_67_EngineCoolantTemp" 104 "S1_PID_68_IntakeAirTempSens" 105 "S1_PID_69_CmdEGR_EGRError" 106 "S1_PID_6A_CmdDieselIntAir" 107 "S1_PID_6B_ExhaustGasTemp" 108 "S1_PID_6C_CmdThrottleActRel" 109 "S1_PID_6D_FuelPresContrSys" 110 "S1_PID_6E_InjPresContrSys" 111 "S1_PID_6F_TurboComprPres" 112 "S1_PID_70_BoostPresCntrl" 128 "S1_PID_80_PIDsSupported_81_A0" 142 "S1_PID_8E_EngFrictionPctTorq" 160 "S1_PID_A0_PIDsSupported_A1_C0" 192 "S1_PID_C0_PIDsSupported_C1_E0" ;
VAL_ 2024 PID_MODE_02 2 "S2_PID_02_FreezeDTC" ;
VAL_ 2024 service 10 "Permanent DTCs (Cleared DTCs) " 9 "Request vehicle information " 8 "Control on-board system " 7 "Show pending DTCs " 6 "Other system monitoring " 5 "Oxygen sensor monitoring " 4 "Clear DTCs and stored values" 3 "Show stored DTCs " 2 "Show freeze frame data " 1 "Show current data " ;

SG_MUL_VAL_ 2024 PIDS_A PID_MODE_01 0-0;
SG_MUL_VAL_ 2024 STATUS PID_MODE_01 1-1;
SG_MUL_VAL_ 2024 FREEZE_DTC PID_MODE_01 2-2;
SG_MUL_VAL_ 2024 FUEL_STATUS PID_MODE_01 3-3;
SG_MUL_VAL_ 2024 ENGINE_LOAD PID_MODE_01 4-4;
SG_MUL_VAL_ 2024 COOLANT_TEMP PID_MODE_01 5-5;
SG_MUL_VAL_ 2024 SHORT_FUEL_TRIM_1 PID_MODE_01 6-6;
SG_MUL_VAL_ 2024 LONG_FUEL_TRIM_1 PID_MODE_01 7-7;
SG_MUL_VAL_ 2024 SHORT_FUEL_TRIM_2 PID_MODE_01 8-8;
SG_MUL_VAL_ 2024 LONG_FUEL_TRIM_2 PID_MODE_01 9-9;
SG_MUL_VAL_ 2024 FUEL_PRESSURE PID_MODE_01 10-10;
SG_MUL_VAL_ 2024 INTAKE_PRESSURE PID_MODE_01 11-11;
SG_MUL_VAL_ 2024 RPM PID_MODE_01 12-12;
SG_MUL_VAL_ 2024 SPEED PID_MODE_01 13-13;
SG_MUL_VAL_ 2024 TIMING_ADVANCE PID_MODE_01 14-14;
SG_MUL_VAL_ 2024 INTAKE_TEMP PID_MODE_01 15-15;
SG_MUL_VAL_ 2024 MAF PID_MODE_01 16-16;
SG_MUL_VAL_ 2024 THROTTLE_POS PID_MODE_01 17-17;
SG_MUL_VAL_ 2024 AIR_STATUS PID_MODE_01 18-18;
SG_MUL_VAL_ 2024 O2_B1S1_V PID_MODE_01 20-20;
SG_MUL_VAL_ 2024 O2_B1S1_STFT PID_MODE_01 20-20;
SG_MUL_VAL_ 2024 O2_B1S2_V PID_MODE_01 21-21;
SG_MUL_VAL_ 2024 O2_B1S2_STFT PID_MODE_01 21-21;
SG_MUL_VAL_ 2024 O2_B1S3_V PID_MODE_01 22-22;
SG_MUL_VAL_ 2024 O2_B1S3_STFT PID_MODE_01 22-22;
SG_MUL_VAL_ 2024 O2_B1S4_V PID_MODE_01 23-23;
SG_MUL_VAL_ 2024 O2_B1S4_STFT PID_MODE_01 23-23;
SG_MUL_VAL_ 2024 O2_B2S1_V PID_MODE_01 24-24;
SG_MUL_VAL_ 2024 O2_B2S1_STFT PID_MODE_01 24-24;
SG_MUL_VAL_ 2024 O2_B2S2_V PID_MODE_01 25-25;
SG_MUL_VAL_ 2024 O2_B2S2_STFT PID_MODE_01 25-25;
SG_MUL_VAL_ 2024 O2_B2S3_V PID_MODE_01 26-26;
SG_MUL_VAL_ 2024 O2_B2S3_STFT PID_MODE_01 26-26;
SG_MUL_VAL_ 2024 O2_B2S4_V PID_MODE_01 27-27;
SG_MUL_VAL_ 2024 O2_B2S4_STFT PID_MODE_01 27-27;
SG_MUL_VAL_ 2024 OBD_COMPLIANCE PID_MODE_01 28-28;
SG_MUL_VAL_ 2024 RUN_TIME PID_MODE_01 31-31;
SG_MUL_VAL_ 2024 PIDS_B PID_MODE_01 32-32;
SG_MUL_VAL_ 2024 DISTANCE_W_MIL PID_MODE_01 33-33;
SG_MUL_VAL_ 2024 FUEL_RAIL_PRESSURE_VAC PID_MODE_01 34-34;
SG_MUL_VAL_ 2024 FUEL_RAIL_PRESSURE_DIRECT PID_MODE_01 35-35;
SG_MUL_VAL_ 2024 O2_S1_WR_VOLTAGE_R PID_MODE_01 36-36;
SG_MUL_VAL_ 2024 O2_S1_WR_VOLTAGE_V PID_MODE_01 36-36;
SG_MUL_VAL_ 2024 O2_S2_WR_VOLTAGE_R PID_MODE_01 37-37;
SG_MUL_VAL_ 2024 O2_S2_WR_VOLTAGE_V PID_MODE_01 37-37;
SG_MUL_VAL_ 2024 O2_S3_WR_VOLTAGE_R PID_MODE_01 38-38;
SG_MUL_VAL_ 2024 O2_S3_WR_VOLTAGE_V PID_MODE_01 38-38;
SG_MUL_VAL_ 2024 O2_S4_WR_VOLTAGE_R PID_MODE_01 39-39;
SG_MUL_VAL_ 2024 O2_S4_WR_VOLTAGE_V PID_MODE_01 39-39;
SG_MUL_VAL_ 2024 O2_S5_WR_VOLTAGE_R PID_MODE_01 40-40;
SG_MUL_VAL_ 2024 O2_S5_WR_VOLTAGE_V PID_MODE_01 40-40;
SG_MUL_VAL_ 2024 O2_S6_WR_VOLTAGE_R PID_MODE_01 41-41;
SG_MUL_VAL_ 2024 O2_S6_WR_VOLTAGE_V PID_MODE_01 41-41;
SG_MUL_VAL_ 2024 O2_S7_WR_VOLTAGE_R PID_MODE_01 42-42;
SG_MUL_VAL_ 2024 O2_S7_WR_VOLTAGE_V PID_MODE_01 42-42;
SG_MUL_VAL_ 2024 O2_S8_WR_VOLTAGE_R PID_MODE_01 43-43;
SG_MUL_VAL_ 2024 O2_S8_WR_VOLTAGE_V PID_MODE_01 43-43;
SG_MUL_VAL_ 2024 COMMANDED_EGR PID_MODE_01 44-44;
SG_MUL_VAL_ 2024 EGR_ERROR PID_MODE_01 45-45;
SG_MUL_VAL_ 2024 EVAPORATIVE_PURGE PID_MODE_01 46-46;
SG_MUL_VAL_ 2024 FUEL_LEVEL PID_MODE_01 47-47;
SG_MUL_VAL_ 2024 WARMUPS_SINCE_DTC_CLEAR PID_MODE_01 48-48;
SG_MUL_VAL_ 2024 DISTANCE_SINCE_DTC_CLEAR PID_MODE_01 49-49;
SG_MUL_VAL_ 2024 EVAP_VAPOR_PRESSURE PID_MODE_01 50-50;
SG_MUL_VAL_ 2024 BAROMETRIC_PRESSURE PID_MODE_01 51-51;
SG_MUL_VAL_ 2024 O2_S1_WR_CURRENT_R PID_MODE_01 52-52;
SG_MUL_VAL_ 2024 O2_S1_WR_CURRENT_I PID_MODE_01 52-52;
SG_MUL_VAL_ 2024 O2_S2_WR_CURRENT_R PID_MODE_01 53-53;
SG_MUL_VAL_ 2024 O2_S2_WR_CURRENT_I PID_MODE_01 53-53;
SG_MUL_VAL_ 2024 O2_S3_WR_CURRENT_R PID_MODE_01 54-54;
SG_MUL_VAL_ 2024 O2_S3_WR_CURRENT_I PID_MODE_01 54-54;
SG_MUL_VAL_ 2024 O2_S4_WR_CURRENT_R PID_MODE_01 55-55;
SG_MUL_VAL_ 2024 O2_S4_WR_CURRENT_I PID_MODE_01 55-55;
SG_MUL_VAL_ 2024 O2_S5_WR_CURRENT_R PID_MODE_01 56-56;
SG_MUL_VAL_ 2024 O2_S5_WR_CURRENT_I PID_MODE_01 56-56;
SG_MUL_VAL_ 2024 O2_S6_WR_CURRENT_R PID_MODE_01 57-57;
SG_MUL_VAL_ 2024 O2_S6_WR_CURRENT_I PID_MODE_01 57-57;
SG_MUL_VAL_ 2024 O2_S7_WR_CURRENT_R PID_MODE_01 58-58;
SG_MUL_VAL_ 2024 O2_S7_WR_CURRENT_I PID_MODE_01 58-58;
SG_MUL_VAL_ 2024 O2_S8_WR_CURRENT_R PID_MODE_01 59-59;
SG_MUL_VAL_ 2024 O2_S8_WR_CURRENT_I PID_MODE_01 59-59;
SG_MUL_VAL_ 2024 CATALYST_TEMP_B1S1 PID_MODE_01 60-60;
SG_MUL_VAL_ 2024 CATALYST_TEMP_B2S1 PID_MODE_01 61-61;
SG_MUL_VAL_ 2024 CATALYST_TEMP_B1S2 PID_MODE_01 62-62;
SG_MUL_VAL_ 2024 CATALYST_TEMP_B2S2 PID_MODE_01 63-63;
SG_MUL_VAL_ 2024 PIDS_C PID_MODE_01 64-64;
SG_MUL_VAL_ 2024 STATUS_DRIVE_CYCLE PID_MODE_01 65-65;
SG_MUL_VAL_ 2024 CONTROL_MODULE_VOLTAGE PID_MODE_01 66-66;
SG_MUL_VAL_ 2024 ABSOLUTE_LOAD PID_MODE_01 67-67;
SG_MUL_VAL_ 2024 COMMANDED_EQUIV_RATIO PID_MODE_01 68-68;
SG_MUL_VAL_ 2024 RELATIVE_THROTTLE_POS PID_MODE_01 69-69;
SG_MUL_VAL_ 2024 AMBIANT_AIR_TEMP PID_MODE_01 70-70;
SG_MUL_VAL_ 2024 THROTTLE_POS_B PID_MODE_01 71-71;
SG_MUL_VAL_ 2024 THROTTLE_POS_C PID_MODE_01 72-72;
SG_MUL_VAL_ 2024 ACCELERATOR_POS_D PID_MODE_01 73-73;
SG_MUL_VAL_ 2024 ACCELERATOR_POS_E PID_MODE_01 74-74;
SG_MUL_VAL_ 2024 ACCELERATOR_POS_F PID_MODE_01 75-75;
SG_MUL_VAL_ 2024 THROTTLE_ACTUATOR PID_MODE_01 76-76;
SG_MUL_VAL_ 2024 RUN_TIME_MIL PID_MODE_01 77-77;
SG_MUL_VAL_ 2024 TIME_SINCE_DTC_CLEARED PID_MODE_01 78-78;
SG_MUL_VAL_ 2024 MAX_FAER_R PID_MODE_01 79-79;
SG_MUL_VAL_ 2024 MAX_FAER_V PID_MODE_01 79-79;
SG_MUL_VAL_ 2024 MAX_FAER_I PID_MODE_01 79-79;
SG_MUL_VAL_ 2024 MAX_FAER_P PID_MODE_01 79-79;
SG_MUL_VAL_ 2024 MAX_MAF PID_MODE_01 80-80;
SG_MUL_VAL_ 2024 FUEL_TYPE PID_MODE_01 81-81;
SG_MUL_VAL_ 2024 ETHANOL_PERCENT PID_MODE_01 82-82;
SG_MUL_VAL_ 2024 EVAP_VAPOR_PRESSURE_ABS PID_MODE_01 83-83;
SG_MUL_VAL_ 2024 EVAP_VAPOR_PRESSURE_ALT PID_MODE_01 84-84;
SG_MUL_VAL_ 2024 SHORT_O2_TRIM_B1 PID_MODE_01 85-85;
SG_MUL_VAL_ 2024 SHORT_O2_TRIM_B3 PID_MODE_01 85-85;
SG_MUL_VAL_ 2024 LONG_O2_TRIM_B1 PID_MODE_01 86-86;
SG_MUL_VAL_ 2024 LONG_O2_TRIM_B3 PID_MODE_01 86-86;
SG_MUL_VAL_ 2024 SHORT_O2_TRIM_B2 PID_MODE_01 87-87;
SG_MUL_VAL_ 2024 SHORT_O2_TRIM_B4 PID_MODE_01 87-87;
SG_MUL_VAL_ 2024 LONG_O2_TRIM_B2 PID_MODE_01 88-88;
SG_MUL_VAL_ 2024 LONG_O2_TRIM_B4 PID_MODE_01 88-88;
SG_MUL_VAL_ 2024 FUEL_RAIL_PRESSURE_ABS PID_MODE_01 89-89;
SG_MUL_VAL_ 2024 RELATIVE_ACCEL_POS PID_MODE_01 90-90;
SG_MUL_VAL_ 2024 HYBRID_BATTERY_REMAINING PID_MODE_01 91-91;
SG_MUL_VAL_ 2024 OIL_TEMP PID_MODE_01 92-92;
SG_MUL_VAL_ 2024 FUEL_INJECT_TIMING PID_MODE_01 93-93;
SG_MUL_VAL_ 2024 FUEL_RATE PID_MODE_01 94-94;
SG_MUL_VAL_ 2024 S1_PID_5F_EmissionReq PID_MODE_01 95-95;
SG_MUL_VAL_ 2024 S1_PID_60_PIDsSupported_61_80 PID_MODE_01 96-96;
SG_MUL_VAL_ 2024 S1_PID_61_DemandEngTorqPct PID_MODE_01 97-97;
SG_MUL_VAL_ 2024 S1_PID_62_ActualEngTorqPct PID_MODE_01 98-98;
SG_MUL_VAL_ 2024 S1_PID_63_EngRefTorq PID_MODE_01 99-99;
SG_MUL_VAL_ 2024 S1_PID_64_EngPctTorq_Idle PID_MODE_01 100-100;
SG_MUL_VAL_ 2024 S1_PID_64_EngPctTorq_EP1 PID_MODE_01 100-100;
SG_MUL_VAL_ 2024 S1_PID_64_EngPctTorq_EP2 PID_MODE_01 100-100;
SG_MUL_VAL_ 2024 S1_PID_64_EngPctTorq_EP3 PID_MODE_01 100-100;
SG_MUL_VAL_ 2024 S1_PID_64_EngPctTorq_EP4 PID_MODE_01 100-100;
SG_MUL_VAL_ 2024 S1_PID_65_AuxInputOutput PID_MODE_01 101-101;
SG_MUL_VAL_ 2024 S1_PID_66_MAFSensor PID_MODE_01 102-102;
SG_MUL_VAL_ 2024 S1_PID_67_EngineCoolantTemp PID_MODE_01 103-103;
SG_MUL_VAL_ 2024 S1_PID_68_IntakeAirTempSens PID_MODE_01 104-104;
SG_MUL_VAL_ 2024 S1_PID_69_CmdEGR_EGRError PID_MODE_01 105-105;
SG_MUL_VAL_ 2024 S1_PID_6A_CmdDieselIntAir PID_MODE_01 106-106;
SG_MUL_VAL_ 2024 S1_PID_6B_ExhaustGasTemp PID_MODE_01 107-107;
SG_MUL_VAL_ 2024 S1_PID_6C_CmdThrottleActRel PID_MODE_01 108-108;
SG_MUL_VAL_ 2024 S1_PID_6D_FuelPresContrSys PID_MODE_01 109-109;
SG_MUL_VAL_ 2024 S1_PID_6E_InjPresContrSys PID_MODE_01 110-110;
SG_MUL_VAL_ 2024 S1_PID_6F_TurboComprPres PID_MODE_01 111-111;
SG_MUL_VAL_ 2024 S1_PID_70_BoostPresCntrl PID_MODE_01 112-112;
SG_MUL_VAL_ 2024 S1_PID_80_PIDsSupported_81_A0 PID_MODE_01 128-128;
SG_MUL_VAL_ 2024 S1_PID_8E_EngFrictionPctTorq PID_MODE_01 142-142;
SG_MUL_VAL_ 2024 S1_PID_A0_PIDsSupported_A1_C0 PID_MODE_01 160-160;
SG_MUL_VAL_ 2024 S1_PID_C0_PIDsSupported_C1_E0 PID_MODE_01 192-192;
SG_MUL_VAL_ 2024 S2_PID_02_FreezeDTC PID_MODE_02 2-2;
SG_MUL_VAL_ 2015 PID_MODE_01 service 1-1;
SG_MUL_VAL_ 2024 PID_MODE_01 service 1-1;
SG_MUL_VAL_ 2024 PID_MODE_02 service 2-2;
